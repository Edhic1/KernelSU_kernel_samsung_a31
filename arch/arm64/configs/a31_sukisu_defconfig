## arch/arm64/configs/a31_sukisu_defconfig
```kconfig
CONFIG_KPM=y          # Required for SukiSU's Kernel Patch Module support
CONFIG_KALLSYMS=y     # For non-GKI, enables symbol table
CONFIG_KALLSYMS_ALL=y # Full symbol table for debugging/modules
```
